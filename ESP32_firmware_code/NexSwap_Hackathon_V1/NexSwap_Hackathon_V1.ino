#include <Arduino.h>
#include <SPI.h>
#include <PN532.h>
#include <PN532_SPI.h>
#include <NfcAdapter.h>
#include "emulatetag.h"
#include "NdefMessage.h"
#include <cctype>
#include <Adafruit_GFX.h>
#include <Adafruit_SSD1306.h>

#define SCREEN_WIDTH 128
#define SCREEN_HEIGHT 64
#define OLED_RESET -1
#define SCREEN_ADDRESS 0x3C

#define VSPI_MOSI 23  // T_DIN
#define VSPI_MISO 19  // T_OUT
#define VSPI_CLK 18   // T_CLK
#define NFC_CS 5      // Chip Select for NFC module (HSPI)

Adafruit_SSD1306 display(SCREEN_WIDTH, SCREEN_HEIGHT, &Wire, OLED_RESET);

SPIClass spiVSPI = SPIClass(VSPI);  // VSPI for NFC and Touchscreen
PN532_SPI pn532spi(spiVSPI, NFC_CS);
EmulateTag nfcEmulator(pn532spi);  // Emulation mode

uint8_t ndefBuf[258];
NdefMessage message;
int messageSize;

uint8_t uid[3] = { 0x12, 0x34, 0x56 };

#define NFC_EMULATION_INTERVAL 200  // Interval in milliseconds
#define BUTTON_PIN 2                // Pin for the button


unsigned long timerStartTime = 0;
unsigned int timerDuration = 0;

void Update_display(void);

// Array of URLs to cycle through
String urlArray[3] = {
  "https://www.linkedin.com/in/dylan-gay-639651298/",
  "https://nexswap-wth-bucket.s3.ap-southeast-2.amazonaws.com/Dylan+Gay+Resume.pdf",
  "https://www.linkedin.com/company/nexswap"
};
const int numUrls = 3;
int currentUrlIndex = 0;  // Track the current URL index

const unsigned char nexswapicon[] PROGMEM = {
  0x00, 0x00, 0x00, 0x00, 0x00, 0x00, 0x00, 0x00, 0x00, 0x00, 0x00, 0x00, 0x00, 0x00, 0x03, 0xff,
  0xf8, 0x00, 0x00, 0x00, 0x00, 0x00, 0x00, 0x00, 0x00, 0x00, 0x1f, 0xff, 0xff, 0x00, 0x00, 0x00,
  0x00, 0x00, 0x00, 0x00, 0x00, 0x00, 0xff, 0xff, 0xff, 0xe0, 0x00, 0x00, 0x04, 0x1c, 0x00, 0x00,
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  0x00, 0x00, 0x00, 0x00, 0x00, 0x00, 0x00, 0xff, 0x80, 0x00, 0x00, 0x00, 0x00, 0x00, 0x00, 0x00
};

const unsigned char fullBatt[] PROGMEM = {
  0x80, 0x00, 0x7f, 0xf0, 0x7f, 0xf8, 0x7f, 0xf8, 0xff, 0xf0, 0x80, 0x00, 0xff, 0xf8
};
const unsigned char halfBatt[] PROGMEM = {
  0xff, 0xf0, 0x7e, 0x00, 0x7e, 0x08, 0x7e, 0x08, 0x7e, 0x00, 0x80, 0x00, 0xff, 0xf8
};
const unsigned char lowBatt[] PROGMEM = {
  0x80, 0x10, 0x60, 0x00, 0x60, 0x08, 0x60, 0x08, 0x60, 0x00, 0x80, 0x00, 0xff, 0xf8
};
const unsigned char noBatt[] PROGMEM = {
  0x01, 0x00, 0xff, 0xf0, 0x80, 0x00, 0x82, 0x08, 0x82, 0x08, 0x80, 0x08, 0x84, 0x00, 0x77, 0xf0,
  0x00, 0x00
};

const unsigned char nexswapLogo[] PROGMEM = {
  0x00, 0x00, 0x00, 0x00, 0x00, 0x00, 0x00, 0x00, 0x00, 0x00, 0x00, 0x00, 0x00, 0x00, 0x00, 0x03,
  0xff, 0xfc, 0x00, 0x00, 0x00, 0x00, 0x00, 0x00, 0x00, 0x00, 0x00, 0x00, 0x1f, 0xff, 0xff, 0x80,
  0x00, 0x00, 0x00, 0x00, 0x00, 0x00, 0x00, 0x00, 0x00, 0x7f, 0xff, 0xff, 0xe0, 0x00, 0x00, 0x04,
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  0x00, 0x00, 0x7f, 0x80, 0x00, 0x00, 0x00, 0x00, 0x00, 0x00, 0x00, 0x00
};

void Update_display(void) {
  static unsigned long lastDisplayUpdateTime = 0;

  int batteryLife = 0;
  int batteryValue = 0;

  if (millis() - lastDisplayUpdateTime >= 100) {
    display.clearDisplay();
    display.setTextSize(1);
    display.setTextColor(SSD1306_WHITE);
    display.setCursor(38, 25);
    display.print("Dylan Gay");
    display.println();
    display.setCursor(30, 35);
    unsigned int elapsedTime = timerDuration;
    display.println("URL Selected");
    display.setCursor(45, 45);
    if (currentUrlIndex == 0) {
      display.print("LinkedIn");
    } else if (currentUrlIndex == 1) {
      display.print("Resume");
    } else if (currentUrlIndex == 2) {
      display.print("Email");
    } else {
      display.print("Error");
    }



    lastDisplayUpdateTime = millis();

    display.display();
  }
}


void setup() {
  Serial.begin(115200);
  Serial.println("------- Emulate Tag --------");

  if (!display.begin(SSD1306_SWITCHCAPVCC, SCREEN_ADDRESS)) {
    Serial.println(F("SSD1306 allocation failed"));
    for (;;)
      ;
  }

  display.clearDisplay();
  display.drawBitmap(10, 2, nexswapLogo, 100, 60, WHITE);
  display.display();
  delay(200);


  pinMode(BUTTON_PIN, INPUT_PULLUP);  // Button with pull-up resisto

  spiVSPI.begin(VSPI_CLK, VSPI_MISO, VSPI_MOSI, NFC_CS);

  initNfcWithUrl(urlArray[currentUrlIndex]);  // Initialize NFC with the first URL
}

void loop() {

  nfcRead();
  delay(10);
  // Check for button press to cycle URLs
  handleButtonPress();
  handleSerialInput();

  Update_display();  // Update the display after scanning
  timerDuration = (millis() - timerStartTime) / 1000;
}

void handleButtonPress() {
  static bool lastButtonState = HIGH;
  bool buttonState = digitalRead(BUTTON_PIN);

  if (lastButtonState == HIGH && buttonState == LOW) {
    // Button pressed
    currentUrlIndex = (currentUrlIndex + 1) % numUrls;  // Cycle to the next URL
    Serial.print("Switching to URL: ");
    Serial.println(urlArray[currentUrlIndex]);
    initNfcWithUrl(urlArray[currentUrlIndex]);  // Update NFC with the new URL
  }

  lastButtonState = buttonState;
}

void handleSerialInput() {
  static String inputBuffer = "";

  while (Serial.available() > 0) {
    char incomingChar = Serial.read();
    inputBuffer += incomingChar;

    // Process the input when "END" is received
    if (inputBuffer.endsWith("END")) {
      if (processInput(inputBuffer)) {
        Serial.println("URLs updated successfully:");
        for (int i = 0; i < numUrls; i++) {
          Serial.print("URL ");
          Serial.print(i + 1);
          Serial.print(": ");
          Serial.println(urlArray[i]);
        }

        // Reinitialize NFC with the updated URLs
        currentUrlIndex = 0;
        initNfcWithUrl(urlArray[currentUrlIndex]);
      } else {
        Serial.println("Invalid input format. Please try again.");
      }

      inputBuffer = "";  // Clear the buffer
    }
  }
}

bool processInput(String input) {
  // Check for "RDY" prefix
  if (!input.startsWith("RDY,")) {
    return false;
  }

  // Remove "RDY," and "END"
  input = input.substring(4, input.length() - 3);

  // Split the input string into URLs
  int urlCount = 0;
  int startIndex = 0;
  int commaIndex = input.indexOf(',');

  while (commaIndex >= 0 && urlCount < numUrls) {
    urlArray[urlCount++] = input.substring(startIndex, commaIndex);
    startIndex = commaIndex + 1;
    commaIndex = input.indexOf(',', startIndex);
  }

  // Add the last URL if there's any
  if (startIndex < input.length() && urlCount < numUrls) {
    urlArray[urlCount++] = input.substring(startIndex);
  }

  return urlCount == numUrls;
}

void initNfcWithUrl(String url) {
  message = NdefMessage();    // Clear the existing message
  message.addUriRecord(url);  // Add the new URL

  messageSize = message.getEncodedSize();
  if (messageSize > sizeof(ndefBuf)) {
    Serial.println("ndefBuf is too small for the message");
    while (1)
      ;  // Halt the program if the buffer is too small
  }

  message.encode(ndefBuf);
  nfcEmulator.init();
  nfcEmulator.setNdefFile(ndefBuf, messageSize);
  nfcEmulator.setUid(uid);

  Serial.print("NDEF encoded message size: ");
  Serial.println(messageSize);
  Serial.print("NFC updated with URL: ");
  Serial.println(url);
}

void nfcRead() {
  bool success = nfcEmulator.emulate(NFC_EMULATION_INTERVAL);
  if (!success) {
    //Serial.println("Emulation timed out");
  } else {
    Serial.println("Emulated");
    animateLink();
  }
}

void animateMatch(void) {

  display.clearDisplay();
  display.drawBitmap(10, 0, nexswapicon, 94, 60, WHITE);
  display.setTextSize(1);
  display.setCursor(80, 50);
  display.display();
  delay(100);
  display.print("Matched");

  display.display();
  delay(2000);
  Update_display();
}

void animateLink(void) {

  display.clearDisplay();
  display.drawBitmap(10, 0, nexswapicon, 94, 60, WHITE);
  display.setTextSize(1);
  display.setCursor(60, 50);
  display.display();
  delay(100);
  display.print("NexSwapped");

  display.display();
  delay(2000);
  Update_display();
}